## conf/distro/hambedded.conf
```bitbake
# Distro configuration for Hambedded
#
# This distro is based on Yocto referance distro with tweaks for
# hamradio users.
#
# Dependencies
# ============
# Poky 1.4

require conf/distro/poky.conf

DISTRO = "hambedded"
DISTRO_NAME = "Hambedded (Embedded Linux For Hamradio)"

MAINTAINER = "Eren Turkay <eren@hambedded.org"

# Have ipk package management by default.
IMAGE_FEATURES += "package-management"
PACKAGE_CLASSES = "package_ipk"

# These variables affect hambedded-feed-configs package
DISTRO_FEED_PREFIX = "hambedded"
DISTRO_FEED_URI = "http://downloads.yoctoproject.org/releases/yocto/yocto-1.4.1/ipk"

# We want to have more than one terminals
SYSVINIT_ENABLED_GETTYS="1 2 3 4 5 6"
```
